## app/src/Kconfig
```kconfig
# Copyright 2026 Michał Bogdziewicz michal@bogdziewicz.xyz
# SPDX-License-Identifier: Apache-2.0

menu "App"

config APP_BOOT_BANNER
        string "Boot banner displayed on app boot"
        default "CWbeat"

module = APP
module-str = app
source "subsys/logging/Kconfig.template.log_config"

endmenu
```

## boards/jbl/go4/Kconfig.jbl_go4
```kconfig
# Copyright 2026 Michał Bogdziewicz michal@bogdziewicz.xyz
# SPDX-License-Identifier: Apache-2.0

config BOARD_JBL_GO4
	select SOC_WS9652A_CPUTOP if BOARD_JBL_GO4_WS9652A_CPUTOP
	select GPIO if BOARD_JBL_GO4_WS9652A_CPUTOP
	select BOARD_ID_GPIO if BOARD_JBL_GO4_WS9652A_CPUTOP
	select WATCHDOG if BOARD_JBL_GO4_WS9652A_CPUTOP
	select WS9652A_PEER if BOARD_JBL_GO4_WS9652A_CPUTOP
```

## boards/jbl/go4/board.yml
```yaml
# SPDX-License-Identifier: Apache-2.0
board:
  name: jbl_go4
  full_name: JBL Go 4 (TOP processor)
  vendor: jbl
  socs:
    - name: ws9652a
```

## boards/jbl/go4/jbl_go4_ws9652a_cputop_defconfig
```kconfig
# SPDX-License-Identifier: Apache-2.0
CONFIG_GPIO=y
CONFIG_SERIAL=y
CONFIG_CONSOLE=y
CONFIG_UART_CONSOLE=y
CONFIG_USB_DEVICE_STACK_NEXT=y
# No hardware-ID provider yet; omit the USB serial-number descriptor.
CONFIG_HWINFO=n
CONFIG_CDC_ACM_SERIAL_INITIALIZE_AT_BOOT=y
CONFIG_CDC_ACM_SERIAL_VID=0x0ac8
CONFIG_CDC_ACM_SERIAL_PID=0xbb91
CONFIG_CDC_ACM_SERIAL_MANUFACTURER_STRING="CWbeat"
CONFIG_CDC_ACM_SERIAL_PRODUCT_STRING="CWbeat console"
CONFIG_CDC_ACM_SERIAL_SELF_POWERED=y
CONFIG_BUILD_OUTPUT_BIN=y
```

## drivers/Kconfig
```kconfig
# SPDX-License-Identifier: Apache-2.0

rsource "pinctrl/Kconfig"
rsource "gpio/Kconfig"
rsource "board_id/Kconfig"
rsource "usb/Kconfig"
rsource "mfd/Kconfig"
rsource "peer/Kconfig"
rsource "mbox/Kconfig"
rsource "misc/Kconfig"
rsource "adc/Kconfig"
rsource "clock_control/Kconfig"
rsource "i2c/Kconfig"
rsource "charger/Kconfig"
rsource "watchdog/Kconfig"
```

## drivers/adc/Kconfig
```kconfig
# SPDX-License-Identifier: Apache-2.0

config ADC_WS9652A
	bool "Experimental WS9652A battery ADC"
	depends on ADC && MFD_WS9652A
	depends on DT_HAS_ZGMICRO_WS9652A_ADC_ENABLED
	help
	  Enable one fixed battery channel using the parent PMU transaction lock.
	  The driver preserves the whole raw result byte; its effective resolution
	  and voltage scale are unknown. The standard ADC API represents this as
	  resolution 8 and returns a zero-extended uint16_t sample. Conversions
	  require completed stock PMU preparation and write control registers.

config ADC_WS9652A_INIT_PRIORITY
	int "WS9652A ADC initialization priority"
	depends on ADC_WS9652A
	default 90
	range MFD_INIT_PRIORITY 99
	help
	  Initialize after the parent PMU, including its generic I2C transport
	  at POST_KERNEL MFD_INIT_PRIORITY. Equal priorities use devicetree
	  dependency ordering. Initialization performs no register accesses.

if ADC_WS9652A

module = ADC_WS9652A
module-str = adc-ws9652a
source "subsys/logging/Kconfig.template.log_config"

endif # ADC_WS9652A
```

## drivers/board_id/Kconfig
```kconfig
# SPDX-License-Identifier: Apache-2.0

config BOARD_ID_GPIO
	bool "GPIO board identifier"
	default y
	depends on GPIO && DT_HAS_GPIO_BOARD_ID_ENABLED
	help
	  Capture a board identifier from GPIO straps during device initialization.
	  GPIO ordering, optional stability sampling and identifier mapping are
	  described by gpio-board-id devicetree nodes.

config BOARD_ID_GPIO_INIT_PRIORITY
	int "GPIO board identifier initialization priority"
	default 80
	depends on BOARD_ID_GPIO
	help
	  POST_KERNEL initialization priority. Set this after the GPIO controllers
	  used by the identification pins. Use zephyr,deferred-init in devicetree
	  when sampling must wait for application-controlled hardware preparation.
```

## drivers/charger/Kconfig
```kconfig
# SPDX-License-Identifier: Apache-2.0

config CHARGER_SC89619D
	bool "Southchip SC89619D battery charger"
	default y
	depends on CHARGER
	depends on DT_HAS_SOUTHCHIP_SC89619D_ENABLED
	select I2C
	select GPIO
	help
	  Read status and configure the SC89619D from devicetree. Unspecified
	  settings are preserved. The enable-charging property holds charging
	  disabled during configuration and enables it only after success.

if CHARGER_SC89619D

module = CHARGER_SC89619D
module-str = charger-sc89619d
source "subsys/logging/Kconfig.template.log_config"

endif # CHARGER_SC89619D

config CHARGER_SHELL
	bool "Charger shell commands"
	depends on CHARGER && SHELL
	help
	  Inspect charger status and properties, configure supported current
	  properties, and enable or disable charging through the charger API.
	  Commands do not initialize devices or change bus ownership.
```

## drivers/clock_control/Kconfig
```kconfig
# SPDX-License-Identifier: Apache-2.0

config CLOCK_CONTROL_WS9652A
	bool "WS9652A inherited clock controller"
	depends on CLOCK_CONTROL
	depends on DT_HAS_ZGMICRO_WS9652A_CLOCK_ENABLED
	help
	  Read the inherited core and bus clock rates with bounded sampling while
	  retained peers may change the clock tree. This driver does not modify
	  PLLs, dividers or clock gates.
```

## drivers/gpio/zgmicro/Kconfig.ws9652a
```kconfig
# SPDX-License-Identifier: Apache-2.0
config GPIO_ZGMICRO_WS9652A
	bool "ZGMICRO WS9652A TOP GPIO"
	default y
	depends on SOC_WS9652A_CPUTOP
	depends on GPIO && DT_HAS_ZGMICRO_WS9652A_GPIO_ENABLED
	select PINCTRL_WS9652A
	help
	  Polled GPIO inputs and output latches for the reverse-engineered Go 4
	  TOP profile. Consumers select direction for any pin made available by
	  devicetree ngpios and gpio-reserved-ranges.
	  GPIO interrupts, pulls, single-ended modes and drive strength are unsupported.
```

## drivers/i2c/Kconfig
```kconfig
# SPDX-License-Identifier: Apache-2.0

config I2C_WS9652A
	bool "WS9652A routed I2C controller"
	depends on I2C && WS9652A_REGISTER_BUS && CLOCK_CONTROL && PINCTRL
	depends on DT_HAS_ZGMICRO_WS9652A_I2C_ENABLED
	default y
	help
	  Bounded polling transfers on external route 0 and internal route 1.
	  The hardware parent owns the transfer engine and receive buffer; channel
	  children expose standard I2C APIs. The shared register-bus lock and its
	  peers-held permission protect complete transfers. Device initialization
	  does not touch hardware. Only standard-speed, 7-bit controller mode is
	  supported, without automatic transfer replay or bus recovery.

if I2C_WS9652A

module = I2C_WS9652A
module-str = i2c-ws9652a
source "subsys/logging/Kconfig.template.log_config"

endif # I2C_WS9652A
```

## drivers/mbox/Kconfig
```kconfig
# SPDX-License-Identifier: Apache-2.0
config MBOX_WS9652A
	bool "WS9652A transmit signal mailbox"
	depends on DT_HAS_ZGMICRO_WS9652A_MBOX_ENABLED
	select MBOX
	default y
```

## drivers/mfd/Kconfig
```kconfig
# SPDX-License-Identifier: Apache-2.0
config MFD_WS9652A
	bool "WS9652A PMU"
	depends on DT_HAS_ZGMICRO_WS9652A_PMU_ENABLED
	select MFD
	select I2C
	default y

if MFD_WS9652A

module = MFD_WS9652A
module-str = mfd-ws9652a
source "subsys/logging/Kconfig.template.log_config"

endif # MFD_WS9652A

config MFD_WS9652A_RUNTIME_READ
	bool "Experimental WS9652A runtime identity reads"
	depends on MFD_WS9652A
	help
	  Allow locally serialized identity reads after successful PMU backend setup,
	  including while the stock peers run. Hardware arbitration between cores
	  is not established. This option alone does not enable runtime PMU writes.
```

## drivers/misc/Kconfig
```kconfig
# SPDX-License-Identifier: Apache-2.0

config WS9652A_REGISTER_BUS
	bool "WS9652A shared register bus domain"
	depends on DT_HAS_ZGMICRO_WS9652A_REGISTER_BUS_ENABLED
	default y
	help
	  Local serialization and verified peer-hold admission for the direct
	  register bridge and routed I2C engine sharing one bit-band gate.
	  Initialization changes no hardware and starts with held-peer admission
	  closed. This provider does not depend on PMU protocol or peer drivers.

if WS9652A_REGISTER_BUS

module = WS9652A_REGISTER_BUS
module-str = ws9652a-register-bus
source "subsys/logging/Kconfig.template.log_config"

endif

config WS9652A_PMU_BRIDGE
	bool "WS9652A direct byte-register bridge"
	depends on DT_HAS_ZGMICRO_WS9652A_PMU_BRIDGE_ENABLED
	depends on WS9652A_REGISTER_BUS
	default y
	help
	  Bounded byte reads and writes through the dedicated internal register
	  engine. Backend selection and PMU policy belong to consumers. Device
	  initialization performs no MMIO.

if WS9652A_PMU_BRIDGE

module = WS9652A_PMU_BRIDGE
module-str = ws9652a-pmu-bridge
source "subsys/logging/Kconfig.template.log_config"

endif
```

## drivers/peer/Kconfig
```kconfig
# SPDX-License-Identifier: Apache-2.0
config WS9652A_PEER
	bool "WS9652A retained peer control"
	depends on DT_HAS_ZGMICRO_WS9652A_PEER_ENABLED
	depends on WATCHDOG
	select MFD_WS9652A
	select WDT_WS9652A
	select PINCTRL_WS9652A if SOC_WS9652A_CPUTOP
	default y

if WS9652A_PEER

module = WS9652A_PEER
module-str = ws9652a-peer
source "subsys/logging/Kconfig.template.log_config"

endif # WS9652A_PEER
```

## drivers/pinctrl/Kconfig
```kconfig
# SPDX-License-Identifier: Apache-2.0
config PINCTRL_WS9652A
	bool "WS9652A verified GPIO configuration and I2C0 routing"
	depends on SOC_WS9652A_CPUTOP
	depends on DT_HAS_ZGMICRO_WS9652A_PINCTRL_ENABLED
	select PINCTRL
	help
	  Apply recovered GPIO routing, direction and latch configuration, and
	  the GPIO7/8 I2C0 mux sequence.
	  Other peripheral muxes, pull resistors and drive strength are unsupported.
```

## drivers/usb/Kconfig
```kconfig
# SPDX-License-Identifier: Apache-2.0

config UDC_WS9652A
	bool "ZGMICRO WS9652A USB device controller"
	default y
	depends on UDC_DRIVER && SOC_WS9652A_CPUTOP
	depends on DT_HAS_ZGMICRO_WS9652A_UDC_ENABLED
	depends on MULTITHREADING
	help
	  Native full-speed USB controller using the recovered TOP register and
	  DMA sequences. A dedicated thread services control and CDC endpoints.
	  No ROM entry points or fixed ROM SRAM workspace are used.

if UDC_WS9652A

config UDC_WS9652A_STACK_SIZE
	int "USB controller thread stack size"
	default 1536
	range 1024 8192

config UDC_WS9652A_THREAD_PRIORITY
	int "USB controller preemptible thread priority"
	default 2
	range 0 14

config UDC_WS9652A_POLL_INTERVAL_MS
	int "USB polling interval in milliseconds"
	default 1
	range 1 10

endif
```

## drivers/watchdog/Kconfig
```kconfig
# SPDX-License-Identifier: Apache-2.0

config WDT_WS9652A
	bool "WS9652A watchdog"
	default y
	depends on WATCHDOG
	depends on DT_HAS_ZGMICRO_WS9652A_WATCHDOG_ENABLED
	help
	  Disable the inherited watchdog using the recovered stock sequence.
	  Timeout installation, setup and feeding are not supported yet.
	  Initialization leaves hardware unchanged; peer and board lifecycle
	  code explicitly decide when to stop the watchdog.
```

## dts/bindings/adc/zgmicro,ws9652a-adc.yaml
```yaml
# SPDX-License-Identifier: Apache-2.0

description: |
  WS9652A PMU battery ADC, a child of zgmicro,ws9652a-pmu. Channel 0 is
  the fixed battery conversion. Samples preserve the full register byte;
  effective resolution and voltage scale are unknown. Sequence resolution
  8 denotes only the raw-byte representation. No millivolt reference is
  supplied. Gain 1, internal reference and default acquisition retain the
  inherited analog configuration without making calibration claims.

compatible: "zgmicro,ws9652a-adc"

include: adc-controller.yaml

properties:
  "#io-channel-cells":
    const: 1

io-channel-cells:
  - input
```

## dts/bindings/audio/jbl,go4-audio.yaml
```yaml
description: Stock codec and type-1 audio control pins owned by the audio subsystem.
compatible: "jbl,go4-audio"
include: base.yaml

properties:
  codec-control-gpios:
    type: phandle-array
    required: true
    description: Codec control output shared with the native power-mode service.
  type1-control-gpios:
    type: phandle-array
    required: true
    description: Additional control output used by type-1 boards.
```
