## CMakeLists.txt
```
# Copyright 2026 Michał Bogdziewicz michal@bogdziewicz.xyz
# SPDX-License-Identifier: Apache-2.0

cmake_minimum_required(VERSION 3.25)

get_filename_component(MODULE_ROOT ${CMAKE_CURRENT_LIST_DIR}/.. ABSOLUTE)
list(APPEND CMAKE_MODULE_PATH ${MODULE_ROOT}/cmake)

include(app_target)

find_package(Zephyr REQUIRED HINTS $ENV{ZEPHYR_BASE})

project(cwbeat)

add_subdirectory(src)
```

## Kconfig
```
# Copyright 2026 Michał Bogdziewicz michal@bogdziewicz.xyz
# SPDX-License-Identifier: Apache-2.0

rsource "src/Kconfig"
source "Kconfig.zephyr"
```

## sample.yaml
```
sample:
  name: CWbeat speaker
  description: Zephyr TOP application using stock Go 4 BT and DSP peers
common:
  platform_allow:
    - jbl_go4/ws9652a/cputop
  tags:
    - audio
    - shell
    - input
tests:
  app.cwbeat:
    build_only: true
```

## prj.conf
```kconfig
# Copyright 2026 Michał Bogdziewicz michal@bogdziewicz.xyz
# SPDX-License-Identifier: Apache-2.0

CONFIG_SIZE_OPTIMIZATIONS=y
CONFIG_MINIMAL_LIBC=y
CONFIG_MAIN_STACK_SIZE=2048
CONFIG_SYSTEM_WORKQUEUE_STACK_SIZE=1536
CONFIG_HEAP_MEM_POOL_SIZE=0
CONFIG_SYS_CLOCK_TICKS_PER_SEC=10000
CONFIG_THREAD_NAME=y
CONFIG_POLL=y
CONFIG_GPIO=y
CONFIG_LED=y
CONFIG_LED_GPIO=y
CONFIG_INPUT=y
CONFIG_INPUT_GPIO_KEYS=y
CONFIG_INPUT_MODE_SYNCHRONOUS=y
CONFIG_SERIAL=y
CONFIG_UART_INTERRUPT_DRIVEN=y
CONFIG_UART_LINE_CTRL=y
CONFIG_SHELL=y
CONFIG_SHELL_BACKEND_SERIAL=y
CONFIG_SHELL_BACKEND_SERIAL_CHECK_DTR=y
# Accept a complete CDC receive FIFO without dropping a multi-packet command.
CONFIG_SHELL_BACKEND_SERIAL_RX_RING_BUFFER_SIZE=256
CONFIG_SHELL_PROMPT_UART="cwbeat> "
CONFIG_SHELL_STACK_SIZE=2048
CONFIG_SHELL_CMD_BUFF_SIZE=128
CONFIG_SHELL_HISTORY=y
CONFIG_SHELL_HISTORY_BUFFER=256
CONFIG_SHELL_LOG_BACKEND=y
CONFIG_LOG=y
# CDC ACM carries the shell logs; logging the transport itself would recurse.
CONFIG_USBD_CDC_ACM_LOG_LEVEL_OFF=y
CONFIG_REBOOT=y

CONFIG_ZBUS=y
CONFIG_MBOX=y

CONFIG_CWBEAT_AUDIO=y
CONFIG_CWBEAT_STOCK_PEER=y
CONFIG_CWBEAT_BLUETOOTH=y
CONFIG_ZBUS_MSG_SUBSCRIBER=n
CONFIG_ZBUS_ASYNC_LISTENER=n
CONFIG_ZBUS_CHANNELS_SYS_INIT_PRIORITY=80

CONFIG_CWBEAT_POWER=y
CONFIG_CWBEAT_POWER_AUTOSTART=y
CONFIG_CWBEAT_UI=y

CONFIG_MFD_WS9652A_RUNTIME_READ=y
CONFIG_ADC=y
CONFIG_ADC_WS9652A=y
CONFIG_CWBEAT_BATTERY=y
CONFIG_CWBEAT_PMU_DIAGNOSTICS=y

CONFIG_I2C=y
CONFIG_I2C_WS9652A=y
CONFIG_CHARGER=y
CONFIG_CHARGER_SC89619D=y
CONFIG_CHARGER_SHELL=y
```

## src/main.c
```c
/*
 * Copyright 2026 Michał Bogdziewicz michal@bogdziewicz.xyz
 * SPDX-License-Identifier: Apache-2.0
 */

#include <zephyr/app_version.h>
#include <zephyr/kernel.h>
#include <zephyr/logging/log.h>

LOG_MODULE_REGISTER(main, CONFIG_APP_LOG_LEVEL);

int main(void)
{
	LOG_INF("CWbeat %s", APP_VERSION_STRING);
	return 0;
}
```
