## dts/bindings/i2c/zgmicro,ws9652a-i2c.yaml
```yaml
# SPDX-License-Identifier: Apache-2.0
description: |
  WS9652A routed I2C register controller. Child channels select external route
  0 or internal route 1. The parent owns one register bank and transfer engine.
  The register-bus provider owns the shared transfer gate and serializes access
  against peer release and direct PMU transactions. No PMU readiness or backend
  selection is required by this controller. Initialization does not touch MMIO.

compatible: "zgmicro,ws9652a-i2c"
include: base.yaml

properties:
  reg:
    required: true
  reg-names:
    required: true
    description: "Single register region named controller."
  clocks:
    required: true
  clock-names:
    required: true
    description: "Clock outputs in order: core, bus."
  register-bus:
    type: phandle
    required: true
    description: Shared transfer gate, mutex and peers-held permission provider.
  "#address-cells":
    type: int
    required: true
    const: 1
  "#size-cells":
    type: int
    required: true
    const: 0
```

## dts/bindings/mbox/zgmicro,ws9652a-mbox.yaml
```yaml
# SPDX-License-Identifier: Apache-2.0
description: WS9652A TX-only channel-zero signal doorbell
compatible: "zgmicro,ws9652a-mbox"
include: [base.yaml, mailbox-controller.yaml]
properties:
  reg:
    required: true
  "#mbox-cells":
    const: 1
mbox-cells:
  - channel
```

## dts/bindings/mfd/ws9652a-pmu-common.yaml
```yaml
# SPDX-License-Identifier: Apache-2.0
description: WS9652A PMU byte-register device
include: base.yaml
```

## dts/bindings/mfd/zgmicro,ws9652a-pmu-bridge.yaml
```yaml
# SPDX-License-Identifier: Apache-2.0
description: |
  WS9652A PMU accessed through the dedicated byte-register bridge. The internal
  I2C connection is used only when needed to select direct mode through C7.
compatible: "zgmicro,ws9652a-pmu"
on-bus: ws9652a-pmu-bridge
include: ws9652a-pmu-common.yaml
properties:
  bootstrap-i2c-bus:
    type: phandle
    required: true
    description: Internal I2C bus reaching this same PMU at fixed address 0x34.
```

## dts/bindings/mfd/zgmicro,ws9652a-pmu-i2c.yaml
```yaml
# SPDX-License-Identifier: Apache-2.0
description: WS9652A PMU accessed through its internal I2C connection at 0x34
compatible: "zgmicro,ws9652a-pmu"
include: [ws9652a-pmu-common.yaml, i2c-device.yaml]
properties:
  direct-bridge:
    type: phandle
    description: |
      Optional direct bridge to the same PMU. Used during preparation to leave
      an inherited direct mode before using I2C; it is not a second PMU device.
```

## dts/bindings/misc/gpio-board-id.yaml
```yaml
# SPDX-License-Identifier: Apache-2.0

description: |
  Board identifier encoded by GPIO straps. The first GPIO supplies bit 0, the
  second bit 1, and so on, using logical GPIO levels (including active-low
  polarity). The resulting bit pattern is the identifier unless id-values supplies
  a lookup table. Zero is a valid identifier.

  Initialization configures every GPIO as an input using the bias flags in its
  GPIO specifier. It does not add an implicit pull.
  Each pin is sampled sample-count times in succession; disagreement fails
  initialization. A successful identifier is cached for the rest of the boot.

  Use zephyr,deferred-init when hardware preparation must precede sampling.
  The application then calls device_init() after the GPIO controllers are
  ready and before another peripheral takes ownership of these pins.

compatible: "gpio-board-id"

include: base.yaml

properties:
  gpios:
    type: phandle-array
    required: true
    description: |
      One to 32 identification GPIOs, ordered from least to most significant
      bit. GPIOs may use different controllers and active-low polarity. Specify
      GPIO_PULL_UP or GPIO_PULL_DOWN only when the strap requires that internal
      bias; omit both for externally biased straps.

  sample-count:
    type: int
    default: 1
    min: 1
    max: 255
    description: Number of identical consecutive samples required for each pin.

  sample-interval-us:
    type: int
    default: 0
    min: 0
    description: Busy-wait interval between successive samples of the same pin.

  id-values:
    type: array
    description: |
      Optional identifiers indexed by the sampled GPIO bit pattern. This must
      contain exactly 2^N entries, where N is the number of GPIOs. For example,
      two GPIOs require four entries ordered for bit patterns 00, 01, 10, 11.
```

## dts/bindings/misc/jbl,go4-stock-ipc.yaml
```yaml
# SPDX-License-Identifier: Apache-2.0
description: JBL Go 4 retained-firmware shared-memory protocol endpoint
compatible: "jbl,go4-stock-ipc"
include: base.yaml
properties:
  memory-region:
    type: phandle
    required: true
  peer-controller:
    type: phandle
    required: true
  board-id:
    type: phandle
    required: true
    description: Board identification device initialized before releasing the peers.
  mboxes:
    required: true
  mbox-names:
    required: true
```

## dts/bindings/misc/zgmicro,ws9652a-pmu-bridge.yaml
```yaml
# SPDX-License-Identifier: Apache-2.0
description: |
  WS9652A dedicated internal byte-register bridge. This controller provides
  indexed reads and writes; it does not select the PMU backend or apply policy.
compatible: "zgmicro,ws9652a-pmu-bridge"
include: base.yaml
bus: ws9652a-pmu-bridge
properties:
  reg:
    required: true
  register-bus:
    type: phandle
    required: true
    description: Shared register-bus lock and gate provider.
```

## dts/bindings/misc/zgmicro,ws9652a-register-bus.yaml
```yaml
# SPDX-License-Identifier: Apache-2.0
description: |
  Shared local serialization and gate for the WS9652A direct register bridge
  and alternate I2C controller. A software admission flag records verified
  peer hold and is closed under the same lock before peer release. This is
  not a hardware semaphore or a cross-core arbitration protocol.
compatible: "zgmicro,ws9652a-register-bus"
include: base.yaml
properties:
  reg:
    required: true
    description: Bit-band gate alias shared by the two register engines.
```

## dts/bindings/peer/zgmicro,ws9652a-peer.yaml
```yaml
# SPDX-License-Identifier: Apache-2.0
description: |
  WS9652A retained BT and DSP hardware control. The optional default pinctrl
  state is applied explicitly after PMU policy and shared-arena initialization,
  before strap detection and BT release. Device init and emergency peer holds
  do not apply it.
compatible: "zgmicro,ws9652a-peer"
include: [base.yaml, pinctrl-device.yaml]
properties:
  reg:
    required: true
  reg-names:
    description: "Register regions in order: bt, mapping, dsp, controller, policy."
    required: true
  watchdog:
    type: phandle
    required: true
    description: |
      WS9652A watchdog stopped after holding BT. Its disable operation must
      be usable before device initialization for emergency peer holds.
  pmu:
    type: phandle
    required: true
  register-bus:
    type: phandle
    required: true
    description: |
      Shared register-bus domain. Normal lifecycle operations publish verified
      peer holds and close transport admission before releasing BT.
  stock-flash-offset:
    type: int
    required: true
```

## dts/bindings/pinctrl/zgmicro,ws9652a-pinctrl.yaml
```yaml
# SPDX-License-Identifier: Apache-2.0
description: |
  WS9652A TOP verified GPIO configuration and GPIO7/8 I2C0 routing.
  States contain groups of pins sharing configuration. Groups are applied
  in declaration order; repeated pins allow recovered configuration
  sequences such as enabling a pull-down followed by disabling it. Explicit
  output-high and output-low latch writes are deferred until every group's
  pad/mux configuration is complete, then applied in declaration order. Without
  a direction or bias property, a group changes only pin routing. A later entry
  for a pin supersedes any pending explicit output level for that same pin.

  Input configuration follows the recovered input sequence: route GPIO,
  enable input mode, set the pin's output alias high, select the pull-down and
  clear CONFIG08. GPIO0.0 retains its pre-routing power-latch level instead.
  Output configuration preserves latches unless an explicit level is given.
  GPIO0.0 output operations affect only its independent power latch, keeping
  the power-button input routing, mode and bias. Explicit bias with an output
  profile on GPIO0.0 is unsupported; configure its input bias separately.
  Both banks support a 22 kOhm pull-down using bias-pull-down. bias-disable
  disables it. Input/output profiles without a bias property disable the pull
  except for GPIO0.0 output profiles. Bias-only groups preserve direction and
  latch levels. Pull-up and drive strength are unsupported.
  I2C0 supports only the complete GPIO0.7/8 mux group without additional pin
  configuration; those pins cannot also select GPIO in the same state.

  For example, a consumer can describe its pins and select a default state:

    &pinctrl {
      peripheral_default: peripheral-default {
        sense {
          pinmux = <WS9652A_PINMUX(0, 11, WS9652A_FUNC_GPIO)>;
          input-enable;
          bias-pull-down;
        };
        enable {
          pinmux = <WS9652A_PINMUX(0, 10, WS9652A_FUNC_GPIO)>;
          output-low;
        };
      };
    };

    &peripheral {
      pinctrl-0 = <&peripheral_default>;
      pinctrl-names = "default";
    };

  The consumer applies this state at its hardware-safe initialization point
  with pinctrl_apply_state(config, PINCTRL_STATE_DEFAULT).

compatible: "zgmicro,ws9652a-pinctrl"
include: base.yaml
properties:
  reg:
    required: true
    description: Routing windows, GPIO port registers and per-pin output aliases.
  reg-names:
    required: true
    description: |
      Ordered bank0, bank1, gpio0, gpio1, pin_output0 and pin_output1 windows.
child-binding:
  description: Pin control state, containing ordered configuration groups.
  child-binding:
    description: Pins sharing a verified configuration.
    include:
      - name: pincfg-node.yaml
        property-allowlist:
          - input-enable
          - output-enable
          - output-low
          - output-high
          - bias-disable
          - bias-pull-down
    properties:
      pinmux:
        type: array
        required: true
        description: Pins encoded with WS9652A_PINMUX(bank, pin, function).
```

## dts/bindings/power/jbl,go4-power.yaml
```yaml
# SPDX-License-Identifier: Apache-2.0

description: |
  JBL Go 4 power latch controls. The power-hold latch is independent of
  the Power button input on GPIO0.0. The stock shutdown sequence also
  clears the GPIO0.3 latch without changing the Play button's input mode.
  Pin direction and shutdown sequencing are selected by board code.

compatible: "jbl,go4-power"

include: base.yaml

properties:
  hold-gpios:
    type: phandle-array
    required: true
    description: Power-hold latch, active high.
  latch-clear-gpios:
    type: phandle-array
    required: true
    description: |
      Output latch forced physically low during terminal shutdown, without
      changing pin direction or mux. GPIO polarity flags do not affect the clear.
```

## dts/bindings/usb/zgmicro,ws9652a-udc.yaml
```yaml
# SPDX-License-Identifier: Apache-2.0

description: |
  ZGMICRO WS9652A TOP native USB device controller. The recovered profile
  supports full-speed control endpoint zero, interrupt IN endpoint one,
  and bulk IN/OUT endpoint two. USB DMA uses driver-owned SRAM buffers.

compatible: "zgmicro,ws9652a-udc"

include: usb-controller.yaml

properties:
  reg:
    required: true
  reg-names:
    required: true
    description: USB controller, DMA channels, DMA interrupt bank, and USB clock gate.
  maximum-speed:
    const: "full-speed"
```

## dts/bindings/watchdog/zgmicro,ws9652a-watchdog.yaml
```yaml
# SPDX-License-Identifier: Apache-2.0

description: |
  WS9652A watchdog in the shared timer block. The driver supports disabling
  the inherited watchdog and preserves the timer channels. Initialization
  does not change hardware; disable also works before device initialization.

compatible: "zgmicro,ws9652a-watchdog"

include: base.yaml

properties:
  reg:
    required: true
```

## soc/zgmicro/ws9652a/Kconfig
```kconfig
# SPDX-License-Identifier: Apache-2.0
config SOC_WS9652A_CPUTOP
	select ARM
	select CPU_CORTEX_M3
	select CPU_CORTEX_M_HAS_DWT
	select SOC_RESET_HOOK
	select SOC_EARLY_INIT_HOOK
	select TIMER_READS_ITS_FREQUENCY_AT_RUNTIME
	select SYSTEM_CLOCK_HW_CYCLES_PER_SEC_RUNTIME_UPDATE
	select INIT_ARCH_HW_AT_BOOT
	select CLOCK_CONTROL
	select CLOCK_CONTROL_WS9652A
```

## soc/zgmicro/ws9652a/Kconfig.defconfig
```kconfig
# SPDX-License-Identifier: Apache-2.0
if SOC_WS9652A_CPUTOP

config NUM_IRQS
	default 32

config SYS_CLOCK_HW_CYCLES_PER_SEC
	default 192000000

config XIP
	default y

endif
```

## soc/zgmicro/ws9652a/Kconfig.soc
```kconfig
# SPDX-License-Identifier: Apache-2.0
config SOC_WS9652A
	bool
	help
	  ZGMICRO WS9652A multiprocessor audio SoC.

config SOC_WS9652A_CPUTOP
	bool
	select SOC_WS9652A
	help
	  WS9652A TOP Cortex-M3 application processor. The BT and DSP processors
	  remain independently managed peers running their original firmware.

config SOC
	default "ws9652a" if SOC_WS9652A
```

## subsys/Kconfig
```kconfig
rsource "stock_peer/Kconfig"
rsource "audio/Kconfig"
rsource "bluetooth/Kconfig"
rsource "power/Kconfig"
rsource "ui/Kconfig"
rsource "battery/Kconfig"
rsource "diagnostics/Kconfig"
```

## subsys/audio/Kconfig
```kconfig
config CWBEAT_AUDIO
 bool "Stock audio controls"
 depends on ZBUS && GPIO
 default y if BOARD_JBL_GO4

if CWBEAT_AUDIO
module = CWBEAT_AUDIO
module-str = CWbeat audio
source "subsys/logging/Kconfig.template.log_config"
endif
```

## subsys/battery/Kconfig
```kconfig
# SPDX-License-Identifier: Apache-2.0

config CWBEAT_BATTERY
	bool "CWbeat stock battery sampling filter"
	depends on ADC_WS9652A
	help
	  Read seven raw battery ADC samples and apply the stock trimmed mean,
	  masking to six bits after averaging. This does not convert to voltage
	  or percentage, or implement a charging policy.
```

## subsys/bluetooth/Kconfig
```kconfig
menuconfig CWBEAT_BLUETOOTH
 bool "Stock Bluetooth session and media"
 depends on CWBEAT_STOCK_PEER && CWBEAT_AUDIO
 default y
if CWBEAT_BLUETOOTH
config CWBEAT_BLUETOOTH_DISABLE_FEEDBACK
 bool "Disable sound feedback before wake"
 default y
config CWBEAT_BLUETOOTH_SHELL
 bool "Bluetooth shell commands"
 depends on SHELL
 default y

module = CWBEAT_BLUETOOTH
module-str = CWbeat Bluetooth
source "subsys/logging/Kconfig.template.log_config"
endif
```

## subsys/diagnostics/Kconfig
```kconfig
# SPDX-License-Identifier: Apache-2.0

config CWBEAT_PMU_DIAGNOSTICS
	bool "Experimental PMU validation shell"
	depends on SHELL && MFD_WS9652A_RUNTIME_READ
	help
	  Enable asynchronous PMU identity probes and, when CWBEAT_BATTERY is
	  enabled, battery ADC probes. Commands use a dedicated work queue and
	  stop on the first error. This is a validation workload, not a battery
	  monitor or charging policy.
```

## subsys/power/Kconfig
```kconfig
# Copyright 2026 Michał Bogdziewicz michal@bogdziewicz.xyz
# SPDX-License-Identifier: Apache-2.0

config CWBEAT_POWER
 bool "Board power intent"
 depends on ZBUS && CWBEAT_BLUETOOTH && CWBEAT_AUDIO
 default y if BOARD_JBL_GO4
config CWBEAT_POWER_AUTOSTART
 bool "Automatically request board power on"
 depends on CWBEAT_POWER
 default y
config CWBEAT_POWER_SHELL
 bool "Power shell commands"
 depends on CWBEAT_POWER && SHELL
 default y

if CWBEAT_POWER
module = CWBEAT_POWER
module-str = CWbeat power
source "subsys/logging/Kconfig.template.log_config"
endif
```
