## tests/stock_peer/testcase.yaml
```yaml
tests:
  cwbeat.stock_peer:
    tags: [stock_peer, cwbeat]
    platform_allow: [qemu_cortex_m3]
    integration_platforms: [qemu_cortex_m3]
```

## tests/subsystems/testcase.yaml
```yaml
tests:
  cwbeat.subsystems.pending_mode4_stop:
    tags: [cwbeat, integration]
    platform_allow: [qemu_cortex_m3]
    integration_platforms: [qemu_cortex_m3]
  cwbeat.subsystems.complete_startup:
    tags: [cwbeat, integration]
    extra_args: [TEST_COMPLETE_STARTUP=ON]
    platform_allow: [qemu_cortex_m3]
    integration_platforms: [qemu_cortex_m3]
```

## tests/ui/testcase.yaml
```yaml
tests:
  cwbeat.ui:
    tags: [ui, gestures, zbus, cwbeat]
    platform_allow: [qemu_cortex_m3]
    integration_platforms: [qemu_cortex_m3]
```

## west.yml
```yaml
manifest:
  defaults:
    remote: upstream

  remotes:
    - name: upstream
      url-base: https://github.com/zephyrproject-rtos

  projects:
    - name: zephyr
      revision: e35b686be50a224e381fd35174be9fcb1a4ddd37
      path: zephyr
      import:
        name-allowlist:
          - cmsis_6
          - segger
      west-commands: scripts/west-commands.yml

  self:
    path: .
```

## zephyr/Kconfig
```kconfig
# Copyright 2026 Michał Bogdziewicz michal@bogdziewicz.xyz
# SPDX-License-Identifier: Apache-2.0

menu "CWbeat"

rsource "../subsys/Kconfig"
rsource "../drivers/Kconfig"

endmenu
```
