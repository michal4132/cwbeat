## subsys/ui/Kconfig
```kconfig
config CWBEAT_UI
 bool "Buttons, gestures and LED indication"
 depends on ZBUS && INPUT && LED && CWBEAT_BLUETOOTH && CWBEAT_POWER
 default y
```

## tests/audio/testcase.yaml
```yaml
tests:
  cwbeat.audio:
    platform_allow: qemu_cortex_m3
    tags: [audio, zbus]
```

## tests/audio_hardware/dts/bindings/gpio/vnd,audio-test-gpio.yaml
```yaml
description: GPIO test controller for audio startup and error handling
compatible: "vnd,audio-test-gpio"
include: gpio-controller.yaml
gpio-cells:
  - pin
  - flags
```

## tests/audio_hardware/testcase.yaml
```yaml
tests:
  cwbeat.audio_hardware:
    tags: [audio, gpio, cwbeat]
    platform_allow: [qemu_cortex_m3]
    integration_platforms: [qemu_cortex_m3]
```

## tests/bluetooth/testcase.yaml
```yaml
tests:
  cwbeat.bluetooth:
    tags: [bluetooth, zbus, cwbeat]
    platform_allow: [qemu_cortex_m3]
    integration_platforms: [qemu_cortex_m3]
  cwbeat.bluetooth.shutdown_timeout:
    tags: [bluetooth, zbus, cwbeat]
    platform_allow: [qemu_cortex_m3]
    integration_platforms: [qemu_cortex_m3]
    extra_args: BT_TEST_SHUTDOWN_TIMEOUT=ON
  cwbeat.bluetooth.completion_overflow:
    tags: [bluetooth, zbus, cwbeat]
    platform_allow: [qemu_cortex_m3]
    integration_platforms: [qemu_cortex_m3]
    extra_args: BT_TEST_COMPLETION_OVERFLOW=ON
  cwbeat.bluetooth.disable_during_cleanup:
    tags: [bluetooth, zbus, cwbeat]
    platform_allow: [qemu_cortex_m3]
    integration_platforms: [qemu_cortex_m3]
    extra_args: BT_TEST_DISABLE_DURING_CLEANUP=ON
```

## tests/boards/jbl_go4_config0c/testcase.yaml
```yaml
tests:
  cwbeat.boards.jbl_go4.config0c:
    platform_allow:
      - jbl_go4/ws9652a/cputop
    integration_platforms:
      - jbl_go4/ws9652a/cputop
    build_only: true
    tags:
      - gpio
      - pinctrl
      - hardware
```

## tests/drivers/board_id_gpio/testcase.yaml
```yaml
common:
  tags: [gpio, board_id]
  platform_allow: [qemu_cortex_m3]
  integration_platforms: [qemu_cortex_m3]
tests:
  cwbeat.drivers.board_id_gpio: {}
```

## tests/drivers/clock_control_ws9652a/testcase.yaml
```yaml
tests:
  cwbeat.drivers.clock_control_ws9652a:
    platform_allow: [qemu_cortex_m3]
    tags: [clock, drivers]
```

## tests/drivers/gpio_ws9652a/testcase.yaml
```yaml
tests:
  cwbeat.drivers.gpio_ws9652a:
    platform_allow:
      - qemu_cortex_m3
    tags:
      - gpio
```

## tests/drivers/i2c_ws9652a/testcase.yaml
```yaml
tests:
  cwbeat.drivers.i2c_ws9652a:
    platform_allow: [qemu_cortex_m3]
    tags: [i2c, pmu]
```

## tests/drivers/mfd_ws9652a/testcase.yaml
```yaml
tests:
  cwbeat.drivers.mfd_ws9652a.policy:
    platform_allow:
      - qemu_cortex_m3
    tags:
      - pmu
      - power
```

## tests/drivers/mfd_ws9652a_battery/testcase.yaml
```yaml
tests:
  cwbeat.drivers.adc_ws9652a.battery:
    platform_allow: [qemu_cortex_m3]
    tags: [adc, pmu, battery]
  cwbeat.drivers.adc_ws9652a.raw:
    platform_allow: [qemu_cortex_m3]
    extra_args: [TEST_BATTERY_HELPER=OFF]
    tags: [adc, pmu, battery]
```

## tests/drivers/mfd_ws9652a_bootstrap/testcase.yaml
```yaml
common:
  platform_allow: [qemu_cortex_m3]
  tags: [i2c, pmu]
tests:
  cwbeat.drivers.mfd_ws9652a.transports: {}
  cwbeat.drivers.mfd_ws9652a.transports_generic:
    extra_args: [TEST_NATIVE_I2C=OFF]
```

## tests/drivers/mfd_ws9652a_runtime/testcase.yaml
```yaml
tests:
  cwbeat.drivers.mfd_ws9652a.runtime:
    platform_allow: [qemu_cortex_m3]
    tags: [pmu]
  cwbeat.drivers.mfd_ws9652a.runtime_disabled:
    platform_allow: [qemu_cortex_m3]
    extra_args: [TEST_RUNTIME_READ=OFF]
    tags: [pmu]
```

## tests/drivers/peer_ws9652a/testcase.yaml
```yaml
common:
  platform_allow:
    - qemu_cortex_m3
  tags:
    - peer
    - pinctrl
tests:
  cwbeat.drivers.peer_ws9652a: {}
  cwbeat.drivers.peer_ws9652a.no_pinctrl:
    extra_configs:
      - CONFIG_PINCTRL=n
```

## tests/drivers/pinctrl_ws9652a/dts/bindings/zephyr,ws9652a-pinctrl-test.yaml
```yaml
# SPDX-License-Identifier: Apache-2.0
description: Test consumer for generated WS9652A pinctrl states
compatible: "zephyr,ws9652a-pinctrl-test"
include: [base.yaml, pinctrl-device.yaml]
```

## tests/drivers/pinctrl_ws9652a/testcase.yaml
```yaml
tests:
  cwbeat.drivers.pinctrl_ws9652a:
    platform_allow:
      - qemu_cortex_m3
    tags:
      - pinctrl
```

## tests/drivers/pmu_bridge_ws9652a/testcase.yaml
```yaml
tests:
  cwbeat.drivers.pmu_bridge_ws9652a:
    platform_allow: [qemu_cortex_m3]
    tags: [pmu]
  cwbeat.drivers.pmu_bridge_ws9652a.logging:
    platform_allow: [qemu_cortex_m3]
    tags: [pmu]
    extra_configs:
      - CONFIG_LOG=y
      - CONFIG_LOG_MODE_IMMEDIATE=y
```

## tests/drivers/register_bus_ws9652a/testcase.yaml
```yaml
tests:
  cwbeat.drivers.register_bus_ws9652a:
    platform_allow: [qemu_cortex_m3]
    tags: [pmu, i2c]
  cwbeat.drivers.register_bus_ws9652a.logging:
    platform_allow: [qemu_cortex_m3]
    tags: [pmu, i2c]
    extra_configs:
      - CONFIG_LOG=y
      - CONFIG_LOG_MODE_IMMEDIATE=y
```

## tests/drivers/udc_ws9652a/testcase.yaml
```yaml
tests:
  cwbeat.drivers.udc_ws9652a_hw:
    platform_allow:
      - qemu_cortex_m3
    tags:
      - usb
```

## tests/drivers/udc_ws9652a_api/testcase.yaml
```yaml
tests:
  cwbeat.drivers.udc_ws9652a_api:
    platform_allow:
      - qemu_cortex_m3
    tags:
      - usb
```

## tests/drivers/wdt_ws9652a/testcase.yaml
```yaml
tests:
  cwbeat.drivers.wdt_ws9652a:
    tags: [watchdog]
    platform_allow: [qemu_cortex_m3]
    integration_platforms: [qemu_cortex_m3]
```

## tests/gestures/testcase.yaml
```yaml
tests:
  cwbeat.gestures:
    tags:
      - input
      - cwbeat
    platform_allow:
      - native_sim
      - qemu_cortex_m3
    integration_platforms:
      - qemu_cortex_m3
```

## tests/power/testcase.yaml
```yaml
tests:
  cwbeat.power:
    platform_allow: qemu_cortex_m3
    tags: [power, zbus]
```

## tests/soc_helpers/testcase.yaml
```yaml
tests:
  cwbeat.soc_helpers:
    tags: [soc, cwbeat]
    platform_allow: [qemu_cortex_m3]
    integration_platforms: [qemu_cortex_m3]
```
